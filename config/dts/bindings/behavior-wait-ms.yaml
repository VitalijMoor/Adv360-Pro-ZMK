## config/dts/bindings/behavior-wait-ms.yaml
```yaml
description: Wait behavior for ZMK

compatible: "zmk,behavior-wait-ms"

include: one_param.yaml

properties:
  wait-ms:
    type: int
    required: true
    description: Time to wait in milliseconds
```

## config/dts/bindings/behaviors/zmk,behavior-unicode-sequence.yaml
```yaml
# zmk,behavior-unicode-sequence.yaml
compatible: "zmk,behavior-unicode-sequence"

include: one_param.yaml

description: Behavior for sending a Unicode codepoint

properties:
  bindings:
    required: true
    type: array
    description: Unicode codepoints to type
```

## config/dts/bindings/behaviors/zmk/behavior-macro-unicode.yaml
```yaml
# SPDX-License-Identifier: MIT

description: Behavior for Unicode macro input

compatible: "zmk,behavior-macro-unicode"

include: one_param.yaml

properties:
  label:
    type: string
    required: false
    deprecated: true
```
